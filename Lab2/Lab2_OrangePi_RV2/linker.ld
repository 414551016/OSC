/* 
這份檔案是 Linker Script（連結腳本），副檔名為 .ld。
它的主要功能是告訴連結器（Linker）如何將編譯好的目標檔案（Object files）組合在一起，並決定各個資料段（Sections）在記憶體中的佈局。
這與您前一份 kernel.its 檔案中定義的 load = <0x00200000>;  相互呼應，確保程式被載入到正確的位置。


關鍵功能說明：
1. 記憶體對齊：此腳本將程式的起點強制設定在 $0x00200000$ ，這對於裸機（Bare-metal）開發或 Bootloader 開發至關重要，因為硬體跳轉後的位址必須與程式碼實際存放位址一致。
2. 啟動順序：透過將 *(.text.boot)  放在最前面，開發者可以確保初始化 CPU 暫存器和堆疊（Stack）的代碼會最先被執行。
3. 段分離：將指令（.text）、唯讀資料（.rodata）與可讀寫資料（.data/.bss）分開，有助於後續進行記憶體保護（例如將指令段設為唯讀以增加安全性）。
*/

/* 指定輸出的硬體架構為 RISC-V */
OUTPUT_ARCH(riscv)

/* 定義程式的執行入口點為 _start 符號（通常位於開機啟動的組合語言中） */
ENTRY(_start)

SECTIONS
{
    /* 設定位置計數器（Location Counter）的起始位址為 0x00200000 */
    /* 這對應到 FIT 檔案中 kernel_1 的載入位址 */
    . = 0x00200000;

    /* .text 段：存放程式的執行碼（指令） */
    .text : {
        *(.text.boot)   /* 首先放置啟動用的代碼（確保開機後第一條指令在此） */
        *(.text*)       /* 接著放置所有輸入檔案中的一般程式碼段 */
    }

    /* .rodata 段：存放唯讀資料（如字串常數、全域 const 變數） */
    .rodata : {
        *(.rodata*)     /* 收集所有輸入檔案中的唯讀資料段 */
    }

    /* .data 段：存放已初始化的全域變數與靜態變數 */
    .data : {
        *(.data*)       /* 收集所有輸入檔案中的已初始化資料段 */
    }

    /* .bss 段：存放未初始化的全域變數（執行前會被清零） */
    .bss : {
        *(.bss*)        /* 收集所有輸入檔案中的 BSS 段 */
        *(COMMON)       /* 收集通用的未定義符號（Common Symbols） */
    }
}